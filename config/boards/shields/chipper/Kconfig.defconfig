## config/xiao_single_button/Kconfig.defconfig
```kconfig
if SHIELD_XIAO_SINGLE_BUTTON

config ZMK_KEYBOARD_NAME
	default "Xiao Single Button Shield"

endif
```

## config/xiao_single_button/Kconfig.shield
```kconfig
config SHIELD_XIAO_SINGLE_BUTTON
    bool "Xiao Single Button Shield"
    depends on BOARD_SEEEDUINO_XIAO_BLE
    help
      If you have a custom shield with a Seeed Xiao and a single GPIO button, say Y here.
```
