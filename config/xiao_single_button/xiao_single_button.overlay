#include <behaviors.dtsi>
#include <dt-bindings/zmk/keys.h>

/ {
    chosen {
        zmk,kscan = &button_grid;
    };

    button_grid: kscan {
        compatible = "zmk,kscan-gpio-direct";
        label = "BUTTON_DIRECT";

        input-gpios
            = <&xiao_d 0 GPIO_ACTIVE_HIGH>,  // This needs to be your actual GPIO pin
            <&ziao_d 1 (GPIO_ACTIVE_LOW | GPIO_PULL_UP)>;

        
    };
};
